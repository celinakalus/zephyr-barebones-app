## CMakeLists.txt
```
cmake_minimum_required(VERSION 3.20.0)

find_package(Zephyr)
project(zephyr_barebones_app)

target_sources(app PRIVATE src/main.c)
```

## Kconfig
```
mainmenu "Zephyr Barebones Application"

source "Kconfig.zephyr"

# Logging
module = MAIN
module-str = main
source "subsys/logging/Kconfig.template.log_config"
```

## prj.conf
```kconfig
CONFIG_LOG=y
CONFIG_MAIN_LOG_LEVEL_INF=y
```

## src/main.c
```c
#include <zephyr/kernel.h>

#include <zephyr/logging/log.h>
LOG_MODULE_REGISTER(main, CONFIG_MAIN_LOG_LEVEL);

int main(void)
{
  LOG_INF("Hello, world!");

  return 0;
}
```
